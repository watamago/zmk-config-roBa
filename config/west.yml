## config/west.yml
```yaml
manifest:
  remotes:
    - name: zmkfirmware
      url-base: https://github.com/zmkfirmware
    - name: kumamuk-git
      url-base: https://github.com/kumamuk-git
  projects:
    - name: zmk
      remote: zmkfirmware
      revision: v0.3.2
      import: app/west.yml

    # PMW3610 外部ドライバ（automouse-layer 対応）
    - name: zmk-pmw3610-driver
      remote: kumamuk-git
      revision: main
      path: modules/zmk-pmw3610-driver

  self:
    path: config
 
  self:
    path: config
```
